## drivers/staging/pi433/Kconfig
```kconfig
# SPDX-License-Identifier: GPL-2.0
config RFMXXX
	tristate "Rrfxxx - are series of radio module by Hoperf"
	depends on SPI
	help
	  This option allows you to enable support for the radio module RFM69xxx.

	  If in doubt, say N here, but saying yes most probably won't hurt
```
